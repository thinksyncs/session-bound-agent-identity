## hal/linux/package/egress-proxy/Config.in
```kconfig
config BR2_PACKAGE_EGRESS_PROXY
	bool "egress-proxy"
	help
	  Cocos Egress Proxy Service.

	  https://github.com/ultravioletrs/cocos
```

## hal/linux/package/log-forwarder/Config.in
```kconfig
config BR2_PACKAGE_LOG_FORWARDER
	bool "log-forwarder"
	help
	  Cocos Log Forwarder service.
```
